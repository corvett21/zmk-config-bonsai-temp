## config/boards/shields/bonsai/Kconfig.defconfig
```kconfig
if SHIELD_BONSAI_LEFT

config ZMK_KEYBOARD_NAME
    default "bonsai"

config ZMK_SPLIT_ROLE_CENTRAL
    default y

endif

if SHIELD_BONSAI_LEFT || SHIELD_BONSAI_RIGHT

config ZMK_SPLIT
    default y

endif
```

## config/boards/shields/bonsai/Kconfig.shield
```kconfig
config SHIELD_BONSAI_LEFT
    def_bool $(shields_list_contains,bonsai_left)

config SHIELD_BONSAI_RIGHT
    def_bool $(shields_list_contains,bonsai_right)
```
